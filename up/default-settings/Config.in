## up/default-settings/Config.in
```kconfig
if PACKAGE_default-settings
comment "Configuration"

config BASE_LUCI_LOGIN
	string
	prompt "Set the default login username for luci"
	default "root"

comment "Packages"

endif
```
